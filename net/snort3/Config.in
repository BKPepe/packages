## net/snort3/Config.in
```kconfig
if PACKAGE_snort3

config SNORT3_ENABLE_TCMALLOC
	bool "Enable tcmalloc"
	depends on !(powerpc || powerpc64 || mips || mipsel || mips64)
	default y
	select PACKAGE_gperftools-runtime

config SNORT3_ENABLE_VECTORSCAN
	bool "Enable Hyperscan (vectorscan)"
	depends on (x86_64 || aarch64)
	default y
	select PACKAGE_vectorscan-runtime

endif
```
